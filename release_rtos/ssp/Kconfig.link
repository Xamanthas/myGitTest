## release_rtos/ssp/Kconfig.link
```kconfig
menu "AmbaLink"

config ENABLE_AMBALINK
	bool "Enable AmbaLink"
	default y
        depends on BUILD_SSP_LINK
	help
	  Enable AmbaLink module.

menu "Ambalink Configuration"
        depends on ENABLE_AMBALINK

config AMBALINK_BOOT_ARM11_LINUX
	bool "Enable AmbaLink on ARM11"
	default n
        depends on ENABLE_AMBALINK && SOC_A9
	help
	  Enable AmbaLink on ARM11.

config AMBALINK_BOSS
	bool "Enable BOSS Feature"
	default y
        depends on ENABLE_AMBALINK
	help
	  Running Linux as a thread in RTOS.

config AMBALINK_MEM_SIZE
	hex "AmbaLink memory size"
	default 0x04000000
        depends on ENABLE_AMBALINK
	help
	  The memory size for AmbaLink (including shared memory and linux).

config AMBALINK_SHARED_MEM_SIZE
	hex "AmbaLink shared memory size"
	default 0x00600000
        depends on ENABLE_AMBALINK
	help
	  The size of shared memory for AmbaLink service.
          The size is calculated from the size and number of rpmsg and some AmbaLink service,
          such as global lock and suspend/resume service.

config AMBALINK_CMDLINE
	string "Command line of AmbaLink"
	default "ubi.mtd=8 root=ubi0:linux rootfstype=ubifs console=ttyS1 nr_cpus=1 maxcpus=0"
        depends on ENABLE_AMBALINK
	help
	  Comand line parameters for AmbaLink

config AMBALINK_RPMSG_SIZE
	int "Size of an RPSMG"
	default 2048
        depends on ENABLE_AMBALINK
	help
	  The memory size of an RPMSG.

config AMBALINK_RPMSG_NUM
	int "Number of RPSMG buffer"
	default 2048
        depends on ENABLE_AMBALINK
	help
	  The maximum number of RPMSG at the same time.

endmenu
endmenu
```

## release_rtos/ssp/Kconfig.prfile2_exfat
```kconfig
#
# This configuration is for prfile2
#
menu "prfile2"

config PF_CHAR_CODE_SET
	string "The coding set for prfile2"
	help
		The coding set for prfile2
	default ASCII

config PF_MAX_DISK
	int "MAX disk"
	default 13

config PF_MAX_VOLUME
	int "MAX volume"
	default 13

config PF_MAX_FILE_NUM
	int "MAX file number"
	default 10

config PF_MAX_DIR_NUM
	int "Max dir number"
	default 3

config PF_MAX_CONTEXT_NUM
	int "max context num"
	default 0

config PF_USE_API_STUB
	int "use api stub"
	default 0

config PF_TASK_PRIORITY
	int "high:0, middle:1, low:2"
	default 1

config PF_TASK_STACK_SIZE
	string "stack size"
	default 0x4000

config PF_PARAM_CHECK_ENABLE
	bool "param check enable"
	default y

config PF_UNICODE_INTERFACE_SUPPORT
	bool "unicode interface support"
	default y

config PF_FREE_CLUSTER_SEARCH_SUPPORT
	bool "free cluster search support"
	default y

config PF_AUTO_REGCTX_SUPPORT
	bool "auto regctx support"
	default n

config PF_AUTO_CONTEXT_REGISTRATION
	bool "auto context registration"
	default n

config PF_MAX_EMPTY_ENTRY_DETECT
	hex "max empty entry detect"
	default 0x1000

config PF_SEQUENTIAL_FILE_DETECT
	bool "sequential file detect"
	default y

config PF_DIRCACHE_SUPPORT
	bool "dircache support"
	default n

config PF_EXFAT_SUPPORT
	bool "exfat support"
	default y

config PF_EXFAT_SET_PERCENT_IN_USE
	bool "set percent in use"
	default n
	depends on PF_EXFAT_SUPPORT

config PF_EXFAT_UPDATE_VOLUME_DIRTY
	bool "update volume dirty"
	default n
	depends on PF_EXFAT_SUPPORT

config PF_EXFAT_CHECK_VOLUME_DIRTY
	bool "check volume dirty"
	default n
	depends on PF_EXFAT_SUPPORT

config PF_EXFAT_FORMAT_SUPPORT
	bool "formate support"
	default y
	depends on PF_EXFAT_SUPPORT

config PF_EXFAT_USE_FAT_CHAIN
	bool "use fat chain"
	default y
	depends on PF_EXFAT_SUPPORT

endmenu
```

## release_rtos/ssp/Kconfig.soc
```kconfig
config ENABLE_L2_CACHE
	bool "Enable L2 cache"
	default y
	help
		Enable L2 Cache.
```

## release_rtos/ssp/Kconfig.svc
```kconfig
menuconfig BUILD_SVC_FRAMEWORK
        bool "Build SVC Framework"
        default n

if BUILD_SVC_FRAMEWORK
config BUILD_SVC_FRAMEWORK_IMAGE
	bool "Build Image Framework"
	default y

config BUILD_SVC_FRAMEWORK_TSMUXER
	bool "Build TS Muxer"
	default n

endif
```

## release_rtos/ssp/Kconfig.threadx
```kconfig
menu "ThreadX Config"

config SSP_THREADX_PROFILE
	bool "ThreadX execution profile support"
	default y
	help
	  ThreadX Execution Profile is designed to track thread
	  execution time based on the hardware timer.
      
config SSP_THREADX_FIQ
	bool "ThreadX FIQ support"
	default y
        depends on !AMBALINK_BOSS
	help
	  This option enables FIQ interrupt handling support in the
	  ThreadX assembly files.
      
config SSP_THREADX_STACK_CHECK
	bool "ThreadX run-time stack checking"
	default y
	help
	  This option enables ThreadX run-time stack checking, which
	  includes analysis of how much stack has been used and 
	  examination of data pattern "fences" before and after the stack area.
	  If a stack error is detected, the registered application stack error
	  handler is called. This option does result in slightly increased overhead
	  and code size.

config SSP_THREADX_EVENT_TRACE
	bool "ThreadX trace feature support"
	default y
	help
	  This option enables the internal ThreadX trace feature. The trace buffer
	  is supplied at a later time via an application call to tx_trace_enable.
      
endmenu
```

## release_rtos/ssp/Kconfig.unittest
```kconfig
config ENABLE_SHMOO_TEST
	bool "Enable Shmoo Test"
	default n
	help
		Automatically doing Shmoo Test.
```

## release_rtos/va/Kconfig.va_adas
```kconfig
config ENABLE_VA_ADAS
        bool "Enable Video Analytic for ADAS"
        default y

config BUILD_VA_ADAS
        depends on ENABLE_VA_ADAS
        bool "Build Video Analytic for ADAS"
        default y
```
