## release_rtos/app/Kconfig
```kconfig
menu "Application"
comment "Application"

config APP
	bool "Build Application"
	default y

if APP
choice
	prompt "Select application"
	default APP_CONNECTED
	help
	  Select Select application

config APP_CONNECTED
	bool "Connected camera"
	help
	  Connected camera

config APP_CONNECTED_MULTI_VIN
	bool "Connected camera with multi-vin"
	help
	  Connected camera with multi-vin
	  
config APP_POLICECAM
	bool "Police camera"
	help
	  Police camera

config APP_CARDV
	bool "Car camera"
	help
	  Car camera	  
	  
endchoice

if APP_CONNECTED
source app/Kconfig.connected
endif

if APP_CONNECTED_MULTI_VIN
source app/Kconfig.connectedmultivin
endif

if APP_POLICECAM
source app/Kconfig.policecam
endif

if APP_CARDV
source app/Kconfig.cardv
endif

endif

endmenu
```

## release_rtos/app/Kconfig.cardv
```kconfig
menu "Car camera application"
comment "Car camera application"
config APP_CARDV_APP
	depends on APP_CARDV
	bool "Build the car camera application"
	default y

if APP_CARDV_APP
source app/Kconfig.cardv.app
endif


config APP_CARDV_APPLIB
	depends on APP_CARDV
	bool "Build the car camera application library"
	default y

if APP_CARDV_APPLIB
source app/Kconfig.cardv.applib
endif

config APP_STAMP
        depends on APP_CARDV
        bool "Enable stamp function"
        default y
		
config APP_AMBA_LINK
        depends on ENABLE_AMBALINK && APP_CARDV
        bool "Enable AMBA LINK"
        default n

config APP_DSP_WORKBUFFER_SIZE
    int "Number of MegaBytes of DSP working buffer"
    default 260
    help
        In MegaBytes unit

config APP_ARD
        depends on APP_CARDV
        bool "Enable ARD function"
        default y

endmenu
```

## release_rtos/app/Kconfig.cardv.applib
```kconfig
menu "Car camera application library"
comment "Car camera application library"

config APP_CARDV_APPLIB_ALL
	depends on APP_CARDV_APPLIB
	bool "Build all of the car camera applib"
	default y

endmenu
```

## release_rtos/app/Kconfig.connected
```kconfig
menu "Connected camera application"
comment "Connected camera application"
config APP_CONNECTED_APP
	depends on APP_CONNECTED
	bool "Build the connected camera application"
	default y

if APP_CONNECTED_APP
source app/Kconfig.connected.app
endif


config APP_CONNECTED_APPLIB
	depends on APP_CONNECTED
	bool "Build the connected camera application library"
	default y

if APP_CONNECTED_APPLIB
source app/Kconfig.connected.applib
endif

config APP_CONNECTED_STAMP
        depends on APP_CONNECTED
        bool "Enable stamp function"
        default y
		
config APP_CONNECTED_PARTIAL_LOAD
        depends on APP_CONNECTED
        bool "Enable partial load"
        default n

config APP_CONNECTED_AMBA_LINK
        depends on ENABLE_AMBALINK && APP_CONNECTED
        bool "Enable AMBA LINK"
        default y

config APP_DSP_WORKBUFFER_SIZE
    int "Number of MegaBytes of DSP working buffer"
    default 260
    help
        In MegaBytes unit

endmenu
```

## release_rtos/app/Kconfig.connected.applib
```kconfig
menu "Connected camera application library"
comment "Connected camera application library"

config APP_CONNECTED_APPLIB_ALL
	depends on APP_CONNECTED_APPLIB
	bool "Build all of the connected camera applib"
	default y

endmenu
```

## release_rtos/app/Kconfig.connectedmultivin
```kconfig
menu "Connected camera with multi-vin application"
comment "Connected camera with multi-vin application"
config APP_CONNECTED_MULTI_VIN_APP
	depends on APP_CONNECTED_MULTI_VIN
	bool "Build the connected camera with multi-vin application"
	default y

if APP_CONNECTED_MULTI_VIN_APP
source app/Kconfig.connectedmultivin.app
endif


config APP_CONNECTED_MULTI_VIN_APPLIB
	depends on APP_CONNECTED_MULTI_VIN
	bool "Build the connected camera with multi-vin application library"
	default y

if APP_CONNECTED_MULTI_VIN_APP
source app/Kconfig.connectedmultivin.applib
endif

config APP_CONNECTED_STAMP
        depends on APP_CONNECTED_MULTI_VIN
        bool "Enable stamp function"
        default y

config APP_CONNECTED_AMBA_LINK
        depends on ENABLE_AMBALINK && APP_CONNECTED_MULTI_VIN
        bool "Enable AMBA LINK"
        default y

config APP_DSP_WORKBUFFER_SIZE
    int "Number of MegaBytes of DSP working buffer"
    default 260
    help
        In MegaBytes unit

endmenu
```

## release_rtos/app/Kconfig.connectedmultivin.applib
```kconfig
menu "Connected camera with multi-vin application library"
comment "Connected camera with multi-vin application library"

config APP_CONNECTED_MULTI_VIN_APPLIB_ALL
	depends on APP_CONNECTED_MULTI_VIN_APPLIB
	bool "Build all of the connected camera with multi-vin applib"
	default y

endmenu
```

## release_rtos/app/Kconfig.policecam
```kconfig
menu "Police camera application"
comment "Police camera application"
config APP_POLICECAM_APP
	depends on APP_POLICECAM
	bool "Build the police camera application"
	default y

if APP_POLICECAM_APP
source app/Kconfig.policecam.app
endif


config APP_POLICECAM_APPLIB
	depends on APP_POLICECAM
	bool "Build the police camera application library"
	default y

if APP_POLICECAM_APPLIB
source app/Kconfig.policecam.applib
endif

config APP_STAMP
        depends on APP_POLICECAM
        bool "Enable stamp function"
        default y
		
config APP_AMBA_LINK
        depends on ENABLE_AMBALINK && APP_POLICECAM
        bool "Enable AMBA LINK"
        default y

config APP_DSP_WORKBUFFER_SIZE
    int "Number of MegaBytes of DSP working buffer"
    default 260
    help
        In MegaBytes unit

config APP_ARD
        depends on APP_POLICECAM
        bool "Enable ARD function"
        default y

endmenu
```

## release_rtos/app/Kconfig.policecam.applib
```kconfig
menu "Police camera application library"
comment "Police camera application library"

config APP_POLICECAM_APPLIB_ALL
	depends on APP_POLICECAM_APPLIB
	bool "Build all of the police camera applib"
	default y

endmenu
```

## release_rtos/audio/Kconfig
```kconfig
menu "Audio"

config AUDIO_SYS
	bool "Audio System Library"
	default y

if AUDIO_SYS
source audio/Kconfig.audio_sys
endif

endmenu
```

## release_rtos/audio/Kconfig.audio_sys
```kconfig
menu "Audio Codec Lib Select"

config ENABLE_AAC_ENCODER
    bool "AAC Encoder"
    default y

config ENABLE_ADPCM_ENCODER
    bool "ADPCM Encoder"
    default n

config ENABLE_AC3_ENCODER
    bool "AC3 Encoder"
    default n

config ENABLE_MPEG_ENCODER
    bool "MPEG Encoder"
    default n

config ENABLE_OPUS_ENCODER
    bool "OPUS Encoder"
    default n

config ENABLE_AAC_DECODER
    bool "AAC Decoder"
    default y

config ENABLE_ADPCM_DECODER
    bool "ADPCM Decoder"
    default n

config ENABLE_AC3_DECODER
    bool "AC3 Decoder"
    default n

config ENABLE_MPEG_DECODER
    bool "MPEG Decoder"
    default n

config ENABLE_OPUS_DECODER
    bool "OPUS Decoder"
    default n

endmenu
```

## release_rtos/bsp/Kconfig
```kconfig
menu "Board Support Package"
comment "Board support package"
choice
	prompt "BSP"
	default BSP_DRAGONFLY

config BSP_DRAGONFLY
	bool "Dragonfly EVK"
	select EXPGPIO
	select EXPGPIO_TI_TCA9539
	select AUDIO_TITLV320AIC3256

config BSP_TAROKO
	bool "TAROKO EVK"
	select NAND_CT49248DD962D1
	select AUDIO_WM8974

config BSP_LIBRA
	bool "LIBRA POLICECAM"
	select NAND_S34ML04G1
	select AUDIO_WM8974

config BSP_BUB
	bool "BUB"
	select NAND_S34ML04G1
	select EXPGPIO
	select EXPGPIO_TI_TCA9539
	select AUDIO_TITLV320AIC3256

config BSP_ARIES
	bool "ARIES CARDV EVK"

config BSP_ASD_LIBRA
	bool "ASD LIBRA POLICECAM"
	select NAND_S34ML04G1
	select AUDIO_WM8974	

config BSP_H902B
	bool "HUBSAN H902B"
	select NAND_CT49248DD962D1
	select AUDIO_WM8974	

endchoice

source peripheral/Kconfig

endmenu
```

## release_rtos/build/Kconfig
```kconfig
#
# For a description of the syntax of this configuration file,
# see build/scripts/Documentation/kbuild/kconfig-language.txt.
#
mainmenu "Ambarella SDK Configuration"

source build/kconfigs/Kconfig.arch
source build/kconfigs/Kconfig.build_options

comment "System Configuration"
source build/kconfigs/Kconfig.system

comment "Modules Configuration"
source app/Kconfig
source audio/Kconfig
source comsvc/Kconfig
source image/Kconfig
source mw/Kconfig
source ssp/Kconfig
source tools/Kconfig
source va/Kconfig

comment "Third-party vendors"
source build/kconfigs/Kconfig.vendors.bt
```

## release_rtos/build/kconfigs/Kconfig.arch
```kconfig
#
# For a description of the syntax of this configuration file,
# see Documentation/kbuild/kconfig-language.txt.
#
comment "Chip Configuration"

choice
	prompt "Ambarella SOC"
	default SOC_A12
	help
	  Select Ambarella SOC series

config SOC_A9
	bool "Ambarella A9 SOC"
	help
	  CPU is ARM11 and Dual Core Cortex A9

config SOC_A12
	bool "Ambarella A12 SOC"
        select CPU_V7
	help
	  CPU is Single Core Cortex A9

config SOC_A11
	bool "Ambarella A11 SOC"
        select CPU_V7
	help
	  CPU is Dual Core Cortex A9

endchoice
```

## release_rtos/build/kconfigs/Kconfig.build_options
```kconfig
#
# For a description of the syntax of this configuration file,
# see build/scripts/Documentation/kbuild/kconfig-language.txt.
#
comment "Build Configuration"

menu "Ambarella Build Targets"

config BUILD_AMBA_SSP_UNITTEST
	bool "Build amba_ssp_ut while make all"
	default n

if BUILD_AMBA_SSP_UNITTEST
config BUILD_AMBA_SSP_UNITTEST_NAME_SH
	string "Custom shell script for linking"
	default "ssp/unittest/link-amba_ssp_unittest.sh"
	help
	  Custom shell script for linking.
	  Path is relative to top tree.

config BUILD_AMBA_SSP_UNITTEST_NAME_LDS
	string "Custom link script"
	default "ssp/unittest/amba_ssp_unittest.lds"
	help
	  Custom link script.
	  Path is relative to top tree.

endif


config BUILD_AMBA_SSP_SVC
        bool "Build amba_ssp_svc while make all"
	default n

if BUILD_AMBA_SSP_SVC
config BUILD_AMBA_SSP_SVC_NAME_SH
	string "Custom shell script for linking"
	default "ssp/svc/link-amba_ssp_svc.sh"
	help
	  Custom shell script for linking.
	  Path is relative to top tree.

config BUILD_AMBA_SSP_SVC_NAME_LDS
	string "Custom link script"
	default "ssp/svc/amba_ssp_svc.lds"
	help
	  Custom link script.
	  Path is relative to top tree.

endif


config BUILD_AMBA_MW_UNITTEST
        bool "Build amba_mw_ut while make all"
	default n

if BUILD_AMBA_MW_UNITTEST
config BUILD_AMBA_MW_UNITTEST_NAME_SH
	string "Custom shell script for linking"
	default "mw/unittest/link-amba_mw_unittest.sh"
	help
	  Custom shell script for linking.
	  Path is relative to top tree.

config BUILD_AMBA_MW_UNITTEST_NAME_LDS
	string "Custom link script"
	default "mw/unittest/amba_mw_unittest.lds"
	help
	  Custom link script.
	  Path is relative to top tree.

endif


config BUILD_AMBA_PBA
        bool "Build amba_pba while make all"
	default y


config BUILD_AMBA_APP
        bool "Build amba_app while make all"
	default n

if BUILD_AMBA_APP
config BUILD_AMBA_APP_NAME_SH
	string "Custom shell script for linking"
	default "app/link-amba_app.sh"
	help
	  Custom shell script for linking.
	  Path is relative to top tree.
	  Default is  if keeping empty.

config BUILD_AMBA_APP_NAME_LDS
	string "Custom link script"
	default "app/amba_app.lds"
	help
	  Custom link script.
	  Path is relative to top tree.
	  Default is  if keeping empty.

endif

endmenu

menu "CPU Options"

menu "ARM CPU ARCH"

config CPU_32v6
	bool

config CPU_32v6K
	bool

config CPU_32v7
	bool

config MMU
	bool

config AEABI
	bool

# ARMv7
config CPU_V7
	bool "Support ARM V7 processor"
	default y
	select CPU_32v6K
	select CPU_32v7
	select MMU
	select AEABI
	help
	  Select for ARMv7, like cortex A9

endmenu

if CPU_V7

choice
	prompt "VFP type"
	default VFP_SOFT
	help
	  Select ARM Floating Point architecture (VFP) type.
	  VFP provides hardware support for floating point operations in
	  half-, single- and double-precision floating point arithmetic.
	  It is fully IEEE 754 compliant with full software library support.

config VFP_V3
	bool "VFP v3"
	help
	  VFPv3 or VFPv3-D32 is an optional extension to the ARM,
	  Thumb and ThumbEE instruction sets in the ARMv7-A and ARMv7-R
	  profiles. VFPv3 implementation is with either thirty-two or
	  sixteen double word registers.

config VFP_SOFT
	bool "Software floating-point"
	help
	   Using software floating-point.

endchoice

config CPU_V7_CA9
	bool "Optimize for Cortex-A9"
	default y
	help
	  Add "-mcpu=cortex-a9"

endif

endmenu

menu "GCC Options"

config DEBUG_INFO
        bool "Compile with debug info"
	default y
	help
	  Compile with debug info, i.e. KBUILD_CFLAGS += -g

choice
	 prompt "gcc optimization level"
	 default CC_OPTIMIZE_0
	 help
	   Set the optimization level for gcc

config CC_OPTIMIZE_0
	bool "optimization level 0"
	help
	  Reduce compilation time and make debugging produce the expected results.
	  Compile C source without optimize. KBUILD_CFLAGS += -O0.

config CC_OPTIMIZE_1
	bool "optimization level 1"
	help
	  Optimize. KBUILD_CFLAGS += -O1.

config CC_OPTIMIZE_2
	bool "optimization level 2"
	help
	  Optimize even more. KBUILD_CFLAGS += -O2.

config CC_OPTIMIZE_3
	bool "optimization level 3"
	help
	  Optimize yet more. KBUILD_CFLAGS += -O3.

endchoice

config FRAME_WARN
	int "Warn for stack frames larger than (needs gcc 4.4)"
	range 0 8192
	default 0
	help
	  Tell gcc to warn at build time for stack frames larger than this.
	  Setting this too low will cause a lot of warnings.
	  Setting it to 0 disables the warning.
	  Requires gcc 4.4

config CC_W_MISSING_BRACES
        bool "Supress warning for missing-braces"
	default y
        help
	  KBUILD_CFLAGS += -Wno-missing-braces

config CC_CXX_SUPPORT
	bool "Support C++ files (code size will be bigger)"
	default n
	help
	  Support C++ files, only *.cpp files.
	  Note-1: libstd++.a is required. So the code size will be bigger.
	  Note-2: cf. http://wiki.osdev.org/C++
	    You need to implement __dso_handle, a handle for the DSO
	    (Dynamic Shared Object) or just declare "void *__dso_handle = NULL;"
	    The operators 'new' and 'delete' are necessary to be implemented
	    for proper memory handle.


choice
	prompt "C Standard"
	default CC_STD_C99
	help
	  Set C standard for gcc

config CC_STD_C99
	bool "ISO C99"
	help
	  Compiled all C files by ISO C99


config CC_STD_GNU99
	bool "ISO GNU99"
	help
	  Compiled all C files by GNU99

endchoice

endmenu
```
