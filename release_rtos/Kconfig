## release_rtos/build/kconfigs/Kconfig.system
```kconfig
#
# For a description of the syntax of this configuration file,
# see build/scripts/Documentation/kbuild/kconfig-language.txt.
#

source bsp/Kconfig
source ssp/Kconfig.link
source ssp/Kconfig.fwprog

menu "System Build Selection"

config BUILD_GPL_LIB
        bool "Build GPL lib"
	default n
	help
	  Enable this option to build GPL lib for experimental purpose only.
	  The GPL programs are located at vendors/gpl.
	  Please DO NOT enable options for MP.

if BUILD_GPL_LIB
config BUILD_GPL_LIB_BM
	bool "Benchmark utilities"
	default n
	help
	  Enable some benchmark utilities, e.g.
	  Dhrystone, Whetstone, Linpack, etc.

endif

menuconfig BUILD_FOSS_LIB
        bool "Build FOSS lib"
	default n
	help
	  Enable this option to build Free Open Source Software.
	  FOSS is non-GPL open source software.

if BUILD_FOSS_LIB
config BUILD_FOSS_GPSD
        bool "Build GPS Daemon in FOSS library"
	default n

config BUILD_FOSS_FREETYPE
        bool "Build Free Type in FOSS library"
	default n

config BUILD_FOSS_OPENCV
        bool "Build OpenCV in FOSS library"
	default n

config BUILD_FOSS_LIBJPEG_TURBO
        bool "Build libjpeg-turbo in FOSS library"
	default n

endif

menu "Host Utility Selection"
config BUILD_HOST_CRC
        bool "Build Host CRC"
	default n
	help
	  Enable this option to build tools/hostutils/host_crc32

config BUILD_HOST_ROMFS_GEN
        bool "Build Host ROMFS Generator"
	default n
	help
	  Enable this option to build tools/hostutils/host_romfs_gen

config BUILD_HOST_PERMUTATE
        bool "Build Host Permutate"
	default n
	help
	  Enable this option to build tools/hostutils/host_permutate

config BUILD_HOST_SDFW_GEN
        bool "Build Host SDFW Generator"
	default y
	help
	  Enable this option to build tools/hostutils/host_sdfw_gen
endmenu

menuconfig BUILD_ASD_LIB
        bool "Build ASD lib"
	default n
	help
	  Enable this option to build ASD Software.
	  
if BUILD_ASD_LIB
config ASD_ADAS_GRAPHICS
        bool "ASD Adas Graphics"
	default y
	help
	  Enable Adas Graphics	  

config ASD_HDMI_PREVIEW
        bool "ASD HDMI Preview"
	default n
	help
	  Enable HDMI Preview	 

config ASD_USB_RS232_ENABLE
        bool "ASD USB to RS232"
	default n
	help
	  Enable USB to RS232

endif

endmenu
```

## release_rtos/build/kconfigs/Kconfig.vendors.bt
```kconfig
menu "Bluetooth"
comment "Bluetooth"

# AMBA Wrapper will be selected if BT is enabled.
config BT
	bool "Support Bluetooth"
	default n
	select BT_AMBA
	select BT_AMBA_SRC
	help
		Say yes here if you want to enable Bluetooth support.

if BT

source build/kconfigs/Kconfig.vendors.bt.ambarella

choice
	prompt "Select vendor of Bluetooth stack"
	help
	  Select vendor of Bluetooth stack.

config BT_BRCM
	bool "Broadcom"
	help
		Usin Broadcom Bluetooth stack.

endchoice


if BT_BRCM

choice
	prompt "Select chip and module maker"
	default BT_BRCM_BCM43340_AW
	help
	  Select chip and module maker.

config BT_BRCM_BCM43340_AW
	bool "bcm43340 from AW"
	help
		bcm43340 from AW.

config BT_BRCM_BCM43340_AMPAK
	bool "bcm43340 from Ampak"
	help
		bcm43340 from Ampak.

config BT_BRCM_BCM43438_A0_AMPAK
	bool "bcm43438-A0 from Ampak"
	help
		bcm43438-A0 from Ampak.
		(AP6212-A0)

config BT_BRCM_BCM43438_A1_AMPAK
	bool "bcm43438-A1 from Ampak"
	help
		bcm43438-A1 from Ampak.
		(AP6212-A1)

config BT_BRCM_BCM43438_AW
	bool "bcm43438 from AW"
	help
		bcm43438 from AW.

config BT_BRCM_BCM43438_USI
	bool "bcm43438 from USI"
	help
		bcm43438 from USI.

config BT_BRCM_BCM43455_AMPAK
	bool "bcm43455 from Ampak"
	help
		bcm43455 from Ampak.
		(AP6255)

endchoice # "Select chip and module maker"

endif # BT_BRCM

endif # BT

endmenu
```

## release_rtos/build/kconfigs/Kconfig.vendors.bt.ambarella
```kconfig
config BT_AMBA
	bool "BT wrapper from Ambarella"
	default y
	help
	  Ambarella provide simple and consistent wrapper for Bluetooth stacks.

if BT_AMBA

config BT_AMBA_SRC
	bool "Have source codes of BT wrapper from Ambarella"
	default n
	help
	  For development.

if BT_AMBA_SRC

config BT_BOOT_RST_BY_SW
	bool "Reset BT by SW when booting up"
	default y
	help
	  HW does not support power sequence well, so need to be reset by SW.

config BT_RST_PIN
	int "Pin number of reseting BT chip"
	default 9
	help
	  Pin number of reseting bluetooth chip.
	  Low: reset
	  High: work

config BT_PM_ENABLE
	bool "Enable BT power management"
	default y
	help
	  If BT chip supports pin to trigger power saving mode, say Y.

config BT_PM_PIN
	int "Pin number of BT chip power management"
	default 8
	help
	  Pin number of BT chip power management.
	  Low: wake-up
	  High: sleep

config BT_AMBA_SMP
	bool "Support SMP pairing"
	default y
	help
	  SMP pairing.
	  Store keys to SD card during SMP for fast bonding.

config BT_BRCM_SNOOP
	bool "Enable snoop log for BT debugging."
	default n
	depends on BT_BRCM
	help
	  Enable snoop log for bluetooth HCI commands.
	  Log will be saved as btsnoop.* at SD card.

endif # BT_AMBA_SRC

endif # BT_AMBA
```

## release_rtos/comsvc/Kconfig
```kconfig
menu "Common Service"
comment "Common Service"
config COMSVC_AMBASHELL
	bool "Build AmbaShell"
	default y
if COMSVC_AMBASHELL
source comsvc/Kconfig.AmbaShell
endif

config COMSVC_AMBASYS
	bool "Build AmbaSys common services"
	default y
if COMSVC_AMBASYS
source comsvc/Kconfig.AmbaSys
endif

config COMSVC_AMBATEST
	bool "Build AmbaTest framewaork"
	default y
if COMSVC_AMBATEST
source comsvc/Kconfig.AmbaTest
endif

config COMSVC_FWUPDATE
	bool "Build Firmware Updater (PBA) Framework"
	default y
if COMSVC_FWUPDATE
source comsvc/Kconfig.FwUpdate
endif

config COMSVC_MISC
	bool "Build misc common services"
	default y
if COMSVC_MISC
source comsvc/Kconfig.misc
endif

config COMSVC_IMAGE
	bool "Build IQ related common services"
	default y
if COMSVC_IMAGE
source comsvc/Kconfig.image
endif

config COMSVC_TUNE
	bool "Build AmbaTune handler services"
	default y
if COMSVC_TUNE
source comsvc/Kconfig.tune
endif


endmenu
```

## release_rtos/image/Kconfig
```kconfig
menu "Image Services"
comment "Image Services"
config IMG_SCHEDULER
	bool "Build Image Scheduler"
	default y

if IMG_SCHEDULER
source image/Kconfig.imgschdlr
endif

config IMG_PROC
	bool "Build Image Wrapper for Algorithm Libraries"
	default y

if IMG_PROC
source image/Kconfig.imgproc
endif

config IMG_CALIBRATION
	bool "Build Image Calibration"
	default y

if IMG_CALIBRATION
source image/Kconfig.imgcalib
endif

config IMG_ITUNER
	bool "Build ITuner Text Parser"
	default y

if IMG_ITUNER
source image/Kconfig.ituner
endif

config IMG_UTILS
	bool "Build Image Utilities"
	default y

if IMG_UTILS
source image/Kconfig.utils
endif

config IMG_ENCMONITOR
	bool "Build Encode Monitor"
	default y

if IMG_ENCMONITOR
source image/Kconfig.encmonitor
endif

menuconfig EIS_TASK
        bool "Build EIS Task"
        default y

if EIS_TASK
source image/Kconfig.eis
endif

endmenu
```
