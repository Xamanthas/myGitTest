## release_rtos/mw/Kconfig
```kconfig
menu "Middleware"
comment "Middleware"
config BUILD_MW_UNITTEST
	bool "Build MW Unit Test"
	default y

if BUILD_MW_UNITTEST
source mw/Kconfig.unittest
endif

config BUILD_MW_FLOW
	bool "Build MW Flow"
	default y

if BUILD_MW_FLOW
source mw/Kconfig.dspflow
endif

config BUILD_MW_SERVICE
	bool "Build MW Service"
	default y

if BUILD_MW_SERVICE
source mw/Kconfig.dataflow
endif

config BUILD_MW_CFS
	bool "Build MW Cached File System"
	default y

if BUILD_MW_CFS
source mw/Kconfig.cfs
endif

config BUILD_MW_NET
	bool "Build MW NET service"
	default y

if BUILD_MW_NET
source mw/Kconfig.net
endif

endmenu
```

## release_rtos/mw/Kconfig.cfs
```kconfig
menu "CFS"
comment "CFS"
config MW_CFS_LOGM_ENABLE
    depends on BUILD_MW_CFS
    bool "Enable CFS Log Module"
    default n

config MW_CFS_GDMA_COPY_ENABLE
    depends on BUILD_MW_CFS
    bool "Enable GDMA Copy"
    default y

endmenu
```

## release_rtos/mw/Kconfig.dspflow
```kconfig
menu "Codec"
comment "Codecs"
config BUILD_MW_CODEC_VIDEOENC
	depends on BUILD_MW_FLOW
	bool "Build MW VideoEnc Codec"
	default y

config BUILD_MW_CODEC_STILLENC
	depends on BUILD_MW_FLOW
	bool "Build MW StillEnc Codec"
	default y

config BUILD_MW_CODEC_AUDIOENC
	depends on BUILD_MW_FLOW
	bool "Build MW AudioEnc Codec"
	default y

config ENABLE_DECODE_MODULE
    depends on BUILD_MW_FLOW
    bool "Enable decode module"
    default y

endmenu
```

## release_rtos/mw/Kconfig.net
```kconfig
menu "Net"
comment "Net"
config MW_NET_CTRL
	depends on BUILD_MW_NET
	bool "Build MW Net Control (Remote API support)"
	default y

config MW_NET_EVENTNOTIFIER
	depends on BUILD_MW_NET
	bool "Build MW Net Event Notifier"
	default y

config MW_NET_FIFO
	depends on BUILD_MW_NET
	bool "Build MW Net FIFO (Streamming)"
	default y

config MW_NET_UTILITY
	depends on BUILD_MW_NET
	bool "Build MW Net Utility"
	default y

endmenu
```

## release_rtos/mw/Kconfig.unittest
```kconfig
menu "Middleware Unit Test"
config MW_UT_DSP_WORKBUFFER_SIZE
	depends on BUILD_MW_UNITTEST
	int "Number of MegaBytes of DSP working buffer"
	default 260
	help
		In MegaBytes unit

config BUILD_MW_UT_VIDEO_ENCODE
    depends on BUILD_MW_FLOW && BUILD_MW_UNITTEST
    bool "Build Video Encode Unit Test"
    default y

config BUILD_MW_UT_STILL_ENCODE
    depends on BUILD_MW_FLOW && BUILD_MW_UNITTEST
    bool "Build Still Encode Unit Test"
    default y

config BUILD_MW_UT_AUDIO_ENCODE
    depends on BUILD_MW_FLOW && BUILD_MW_UNITTEST
    bool "Build Audio Encode Unit Test"
    default y

config BUILD_MW_UT_EXT_ENCODE
    depends on BUILD_MW_FLOW && BUILD_MW_UNITTEST
    bool "Build External Encode Unit Test"
    default y

config BUILD_MW_UT_YUV_ENCODE
    depends on BUILD_MW_FLOW && BUILD_MW_UNITTEST
    bool "Build Yuv Encode Unit Test"
    default y

config BUILD_MW_UT_AV_ENCODE
    depends on BUILD_MW_FLOW && BUILD_MW_UNITTEST
    bool "Build Av Encode Unit Test"
    default y

config BUILD_MW_UT_DUAL_VIN_ENCODE
    depends on BUILD_MW_FLOW && BUILD_MW_UNITTEST
    bool "Build Dual Vin Encode Unit Test"
    default y

config BUILD_MW_UT_ENC_TRANSCODE
    depends on BUILD_MW_FLOW && BUILD_MW_UNITTEST
    bool "Build Encode Transcode Unit Test"
    default y

config BUILD_MW_UT_VIDEO_DECODE
    depends on BUILD_MW_FLOW && BUILD_MW_UNITTEST
    bool "Build Video Decode Unit Test"
    default y

config BUILD_MW_UT_AUDIO_DECODE
    depends on BUILD_MW_FLOW && BUILD_MW_UNITTEST
    bool "Build Audio Decode/Beep Unit Test"
    default y

config BUILD_MW_UT_STILL_DECODE
    depends on BUILD_MW_FLOW && BUILD_MW_UNITTEST
    bool "Build Still Decode Unit Test"
    default y

config BUILD_MW_UT_VA
    depends on BUILD_MW_FLOW && BUILD_MW_UNITTEST
    bool "Build VA Unit Test"
    default y

config BUILD_MW_UT_DEC_TRANSCODE
    depends on BUILD_MW_FLOW && BUILD_MW_UNITTEST
    bool "Build Dec Transcode Unit Test"
    default y

config BUILD_MW_UT_CFS
    depends on BUILD_MW_CFS && BUILD_MW_UNITTEST
    bool "Build CFS Unit Test"
    default y

if BUILD_MW_UT_CFS
    source mw/unittest/Kconfig.unittest.cfs
endif

config BUILD_MW_UT_DCF
    depends on BUILD_MW_CFS && BUILD_MW_UNITTEST
    bool "Build DCF Unit Test"
    default y

config BUILD_MW_UT_EDITOR
    depends on BUILD_MW_CFS && BUILD_MW_FLOW && BUILD_MW_SERVICE && BUILD_MW_UNITTEST
    bool "Build Editor Unit Test"
    default y

config BUILD_MW_UT_EMERGENCY_RECORDING
    depends on BUILD_MW_CFS && BUILD_MW_FLOW && BUILD_MW_SERVICE && BUILD_MW_UNITTEST
    bool "Build Emergency Recording Unit Test"
    default y

config BUILD_MW_UT_EVENT_RECORDING
    depends on BUILD_MW_CFS && BUILD_MW_FLOW && BUILD_MW_SERVICE && BUILD_MW_UNITTEST
    bool "Build Event Recording Unit Test"
    default y

config BUILD_MW_UT_EXIF_DMX
    depends on BUILD_MW_CFS && BUILD_MW_FLOW && BUILD_MW_SERVICE && BUILD_MW_UNITTEST
    bool "Build EXIF Demuxer Unit Test"
    default y

config BUILD_MW_UT_EXIF_MUX
    depends on BUILD_MW_CFS && BUILD_MW_FLOW && BUILD_MW_SERVICE && BUILD_MW_UNITTEST
    bool "Build EXIF Muxer Unit Test"
    default y

config BUILD_MW_UT_EXT_DMX
    depends on BUILD_MW_CFS && BUILD_MW_FLOW && BUILD_MW_SERVICE && BUILD_MW_UNITTEST
    bool "Build External Demuxer Unit Test"
    default y

config BUILD_MW_UT_EXT_MUX
    depends on BUILD_MW_CFS && BUILD_MW_FLOW && BUILD_MW_SERVICE && BUILD_MW_UNITTEST
    bool "Build External Muxer Unit Test"
    default y

config BUILD_MW_UT_FIO
    depends on BUILD_MW_CFS && BUILD_MW_FLOW && BUILD_MW_SERVICE && BUILD_MW_UNITTEST
    bool "Build FIO Unit Test"
    default y

config BUILD_MW_UT_MKV_DMX
    depends on BUILD_MW_CFS && BUILD_MW_FLOW && BUILD_MW_SERVICE && BUILD_MW_UNITTEST
    bool "Build Matroska Demuxer Unit Test"
    default y

config BUILD_MW_UT_MKV_MUX
    depends on BUILD_MW_CFS && BUILD_MW_FLOW && BUILD_MW_SERVICE && BUILD_MW_UNITTEST
    bool "Build Matroska Muxer Unit Test"
    default y

config BUILD_MW_UT_MOV_DMX
    depends on BUILD_MW_CFS && BUILD_MW_FLOW && BUILD_MW_SERVICE && BUILD_MW_UNITTEST
    bool "Build MOV Demuxer Unit Test"
    default y

config BUILD_MW_UT_MOV_MUX
    depends on BUILD_MW_CFS && BUILD_MW_FLOW && BUILD_MW_SERVICE && BUILD_MW_UNITTEST
    bool "Build MOV Muxer Unit Test"
    default y

config BUILD_MW_UT_MP4_DMX
    depends on BUILD_MW_CFS && BUILD_MW_FLOW && BUILD_MW_SERVICE && BUILD_MW_UNITTEST
    bool "Build MP4 Demuxer Unit Test"
    default y

config BUILD_MW_UT_MP4_MUX
    depends on BUILD_MW_CFS && BUILD_MW_FLOW && BUILD_MW_SERVICE && BUILD_MW_UNITTEST
    bool "Build MP4 Muxer Unit Test"
    default y

endmenu
```

## release_rtos/mw/unittest/Kconfig.unittest.cfs
```kconfig
config MW_UT_CFS_DTA_AMOUNT
	depends on BUILD_MW_UNITTEST && BUILD_MW_CFS
	int "Max Number of CFS DTA"
	default 2
```

## release_rtos/peripheral/Kconfig
```kconfig
menu "Peripheral"
source peripheral/dram/Kconfig.dram
source peripheral/sbrg/Kconfig.sbrg
source peripheral/sensor/Kconfig.sensor
source peripheral/yuvinput/Kconfig.yuvinput
source peripheral/lcd/Kconfig.lcd
source peripheral/imu/Kconfig.imu
source peripheral/nand/Kconfig.nand
source peripheral/nor/Kconfig.nor
source peripheral/audio/Kconfig.audio
source peripheral/misc/Kconfig.misc
source peripheral/gps/Kconfig.gps
source peripheral/g_sensor/Kconfig.g_sensor
endmenu
```

## release_rtos/peripheral/audio/Kconfig.audio
```kconfig
menu "Audio codec Driver"

config AUDIO_TITLV320AIC3256
	bool "TI tlv320aic3256"
	default y
config AUDIO_WM8974
	bool "Wolfson Microelectronics WM8974"
	default n
config AUDIO_ALC5660
	bool "REALTEK ALC5660"
	default y

config AUDIO_AK4951EN
	bool "AKM AK4951EN"
	default n
	
endmenu
```

## release_rtos/peripheral/dram/Kconfig.dram
```kconfig
menu "DRAM Config"
config DDR_SIZE
	hex "Physical DRAM size in Bytes"
	default 0x40000000

config DRAM_DDR3_K4B2G1646CHCK0_32B_600Mhz
	bool "DDR3 K4B2G1646CHCK0 32BIT 600MHZ"
	default n

config DRAM_DDR3_K4B4G1646BHCK0_16BIT_396MHZ
	bool "DDR3 K4B4G1646BHCK0 16BIT 396MHZ"
	default n

config DRAM_DDR3_K4B4G1646BHCK0_16BIT_600MHZ
	bool "DDR3 K4B4G1646BHCK0 16BIT 600MHZ"
	default n

config DRAM_DDR3_K4B4G1646BHCK0_32BIT_396MHZ
	bool "DDR3 K4B4G1646BHCK0 32BIT 396MHZ"
	default n

config DRAM_DDR3_K4B4G1646BHCK0_32BIT_600MHZ
	bool "DDR3 K4B4G1646BHCK0 32BIT 600MHZ"
	default y

config DRAM_DDR3_CT49488DD962D1_32BIT_396MHZ
	bool "DDR3L CT49488DD962D1 32BIT 396MHZ"
	default n

config DRAM_DDR3_CT49488DD962D1_32BIT_600MHZ
	bool "DDR3L CT49488DD962D1 32BIT 600MHZ"
	default n
	
config DRAM_LPDDR2_MT42L128M32D1GU
	bool "LPDDR2 MT42L128M32D1GU"
	default n

config DRAM_LPDDR2_MT42L256M32D4
	bool "LPDDR2 MT42L256M32D4"
	default n

config DRAM_LPDDR3_K4E8E304EDEGCE
	bool "LPDDR3 K4E8E304EDEGCE"
	default n

config DRAM_LPDDR3_EDF8132A3MA_600MHZ
	bool "LPDDR3 EDF8132A3MA-JD-F-D 600MHZ"
	default n

config DRAM_LPDDR3_EDF8132A3MA_396MHZ
	bool "LPDDR3 EDF8132A3MA-JD-F-D 396MHZ"
	default n

config DRAM_LPDDR3_H9CCNNN8GTMLAR_600MHZ
	bool "LPDDR3 H9CCNNN8GTMLAR 600MHZ"
	default n

config DRAM_LPDDR3_NT6CL256M16BM_600MHZ
	bool "LPDDR3 NT6CL256M16BM 600MHZ"
	default n

endmenu
```

## release_rtos/peripheral/g_sensor/Kconfig.g_sensor
```kconfig
menu "G-SENSOR Driver"

config G_SENSOR_ST_LIS3DE
        bool "G_SENSOR_ST_LIS3DE"
        default n
endmenu
```

## release_rtos/peripheral/gps/Kconfig.gps
```kconfig
menu "GPS Driver"

config GPS_UBLOX6_GM6XX
        bool "GPS_GM6XX"
        default n
endmenu
```

## release_rtos/peripheral/imu/Kconfig.imu
```kconfig
menu "IMU Driver"

config IMU_AMBARELLA_DMY0000
    bool "Ambarella dummy IMU"
    default y
    
config IMU_INVENSENSE_MPU6500
    bool "Invensense MPU6500"
    default y

config IMU_INVENSENSE_ICM20608
    bool "Invensense ICM20608"
    default n

endmenu
```

## release_rtos/peripheral/lcd/Kconfig.lcd
```kconfig
menu "LCD Driver"

config LCD_WDF9648W
	bool "Wintek WDF9648W"
	default y

config LCD_T20P52
	bool "T20O52"
	default n

config LCD_EG020THEG1
	bool "EG020THEG1"
	default n

config LCD_T27P05
	bool "T27P05"
    default n

config LCD_T30P61
	bool "T30P61"
    default n
	
endmenu
```

## release_rtos/peripheral/misc/Kconfig.misc
```kconfig
menu "MISC Drivers"

config EXPGPIO
	bool "Expand GPIO"
	default n

config EXPGPIO_TI_TCA9539
	depends on EXPGPIO
	bool "- TI TCA9539 Expand GPIO"
	default y

config IRDA
	bool "Infrared Controller"
	default y

config IRDA_SONY
	depends on IRDA
	bool "- SONY IrDA Protocol"
	default n

config IRDA_PHILIPS
	depends on IRDA
	bool "- PHILIPS IrDA Protocol"
	default n

config IRDA_PANASONIC
	depends on IRDA
	bool "- PANASONIC IrDA Protocol"
	default n

config IRDA_NEC
	depends on IRDA
	bool "- NEC IrDA Protocol"
	default n

endmenu
```

## release_rtos/peripheral/nand/Kconfig.nand
```kconfig
menu "NAND Driver"

config NAND_CT49248DD962D1
	bool "CT49248DD962D1"
	default n

config NAND_CT49248NS962D1
	bool "CT49248NS962D1"
	default n

config NAND_H27U2G8F2C
	bool "H27U2G8F2C"
	default n

config NAND_S34ML04G1
	bool "S34ML04G1"
	default n

config NAND_S34ML04G2
	bool "S34ML04G2"
	default n	

config NAND_S34ML02G1
	bool "S34ML02G1"
	default n

config NAND_S34ML02G2
	bool "S34ML02G2"
	default n	

config NAND_S34ML01G1
	bool "S34ML01G1"
	default n	

config NAND_S34ML01G2
	bool "S34ML01G2"
	default n	

config NAND_MX30LF1G08AA
	bool "MX30LF1G08AA"
	default n	

config NAND_MX30UF2G16AB
	bool "MX30UF2G16AB"
	default n

config NAND_K9F2G08U0C
	bool "K9F2G08U0C"
	default n

config NAND_F59L1G81A
	bool "ESMT F59L1G81A"
	default n

config NAND_PSU2GA30BT
	bool "PSU2G30BT"
	default n

config NAND_PSU4GA30AT
	bool "PSU4G30AT"
	default n
endmenu
```

## release_rtos/peripheral/nor/Kconfig.nor
```kconfig
menu "NOR Driver"

config NOR_S25FL256S
	bool "S25FL256S"
	default n

config NOR_W25Q64FV
	bool "W25Q64FV"
	default n
endmenu
```

## release_rtos/peripheral/sbrg/Kconfig.sbrg
```kconfig
menu "Sensor bridge Driver"

config SBRIDGE_TI913914
	bool "TI 913/914"
	default y


config SBRIDGE_AMBA_B5
	bool "Ambarella B5"
	default n

endmenu
```

## release_rtos/peripheral/sensor/Kconfig.sensor
```kconfig
menu "Sensor Driver"

config SENSOR_SONY_IMX117
    bool "Sony IMX117"
    default n

config SENSOR_SONY_IMX377
    bool "Sony IMX377"
    default n

config SENSOR_OV4689
    bool "OmniVision OV4689"
    default n
    
config SENSOR_B5_OV4689
    bool "B5 plus OmniVision OV4689"
    default n

config SENSOR_TI913914_OV2710
    bool "TI913/914 OV2710"
    default n

config SENSOR_SONY_IMX206
    bool "Sony IMX206"
    default n
    
config SENSOR_OV10823
    bool "OmniVision OV10823"
    default n
    
config SENSOR_AR0330_PARALLEL
    bool "Aptina AR0330 PARALLEL"
    default n

config SENSOR_AR0230
    bool "Aptina AR0230 HiSPi"
    default n

config SENSOR_OV9750
    bool "OmniVision OV9750"
    default n
    
config SENSOR_MN34120
    bool "Panasonic MN34120"
    default n

config SENSOR_SONY_IMX290
    bool "Sony IMX290"
    default n

config SENSOR_SONY_IMX179
    bool "Sony IMX179"
    default n

config SENSOR_B5_AR0230
    bool "B5 plus Aptina AR0230"
    default n

config SENSOR_B5_OV9750
    bool "B5 plus OmniVision OV9750"
    default n

config SENSOR_MN34222
    bool "Panasonic MN34222"
    default n

config SENSOR_AR1335
    bool "Aptina AR1335"
    default n

endmenu
```

## release_rtos/peripheral/yuvinput/Kconfig.yuvinput
```kconfig
menu "YUV input Driver"

config YUVINPUT_TI5150
	bool "TI 5150"
	default n
endmenu
```

## release_rtos/ssp/Kconfig
```kconfig
menu "System Support Package"

menuconfig BUILD_SSP_AMBOOT
        bool "Build Amboot"
        default y

source ssp/Kconfig.amboot

menuconfig BUILD_SSP_DSP
        bool "Build Dsp Support Package"
        default y

if BUILD_SSP_DSP
source ssp/Kconfig.dsp
endif

menuconfig BUILD_SSP_FS
        bool "Build AmbaFS"
        default y

if BUILD_SSP_FS
source ssp/Kconfig.fs
endif

menuconfig BUILD_SSP_KAL
        bool "Build AmbaKAL"
        default y

if BUILD_SSP_KAL
source ssp/Kconfig.kal
endif

menuconfig BUILD_SSP_LINK
        bool "Build AmbaLink"
        default y

menuconfig BUILD_SSP_SOC
        bool "Build SOC"
        default y

if BUILD_SSP_SOC
source ssp/Kconfig.soc
endif

menuconfig BUILD_SSP_SVC
        bool "Build SerVice Code"
        default y

if BUILD_SSP_SVC
source ssp/Kconfig.svc
endif

menuconfig BUILD_SSP_USB
        bool "Build AmbaUSB"
        default y

if BUILD_SSP_USB
source ssp/Kconfig.usb
endif

menuconfig BUILD_SSP_USBX
        bool "Build USBX"
        default y

if BUILD_SSP_USBX
source ssp/Kconfig.usbx
endif

comment "Unit Test"
menuconfig BUILD_SSP_UNITTEST
        bool "Build SSP UnitTest"
        default y

if BUILD_SSP_UNITTEST
source ssp/Kconfig.unittest
endif

endmenu
```
